## config/west.yml
```yaml
manifest:
  remotes:
    - name: zmkfirmware
      url-base: https://github.com/zmkfirmware
    - name: badjeff
      url-base: https://github.com/badjeff
    - name: mctechnology17
      url-base: https://github.com/mctechnology17
#    - name: gpeye                         #hammerbean slideshow
 #     url-base: https://github.com/GPeye  
  projects:
    - name: zmk
      remote: zmkfirmware
      revision: main
      import: app/west.yml
    - name: zmk-pmw3610-driver
      remote: badjeff
      revision: main
    - name: zmk-nice-oled
      remote: mctechnology17
      revision: main
#    - name: hammerbeam-slideshow         
 #     remote: gpeye                       
  #    revision: main                      
  self:
    path: config
```
